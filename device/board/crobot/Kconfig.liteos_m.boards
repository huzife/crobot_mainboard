## device/board/crobot/Kconfig.liteos_m.boards
```kconfig
if SOC_STM32F405RGT6
    orsource "stm32f405_crobot/Kconfig.liteos_m.board"
endif
```

## device/board/crobot/stm32f405_crobot/Kconfig.liteos_m.board
```kconfig
config BOARD_STM32F405_CROBOT
    bool "select board STM32F405"
    depends on SOC_STM32F405RGT6

menu "Device Configuration"
    depends on BOARD_STM32F405_CROBOT

choice ROBOT_BASE_CONFIG
    prompt "robot base config"

config ROBOT_BASE_NONE
    bool "configured by host"

config ROBOT_BASE_2WD
    bool "two-wheel differential"

config ROBOT_BASE_2WD_RADIUS
    int "wheel radius(0.1mm)"
    range 1 10000
    default 325
    depends on ROBOT_BASE_2WD

config ROBOT_BASE_2WD_SEPARATION
    int "wheel separation(0.1mm)"
    range 1 10000
    default 1720
    depends on ROBOT_BASE_2WD

config ROBOT_BASE_3WO
    bool "three-wheel omnidirectional"

config ROBOT_BASE_3WO_RADIUS
    int "wheel radius(0.1mm)"
    range 1 10000
    default 290
    depends on ROBOT_BASE_3WO

config ROBOT_BASE_3WO_DISTANCE
    int "distance from wheel to center(0.1mm)"
    range 1 10000
    default 1050
    depends on ROBOT_BASE_3WO

config ROBOT_BASE_4WD
    bool "four-wheel differential"

config ROBOT_BASE_4WD_RADIUS
    int "wheel radius(0.1mm)"
    range 1 10000
    default 325
    depends on ROBOT_BASE_4WD

config ROBOT_BASE_4WD_SEPARATION
    int "wheel separation(0.1mm)"
    range 1 10000
    default 1720
    depends on ROBOT_BASE_4WD

config ROBOT_BASE_4MEC
    bool "four-mecanum-wheel"

config ROBOT_BASE_4MEC_RADIUS
    int "wheel radius(0.1mm)"
    range 1 10000
    default 490
    depends on ROBOT_BASE_4MEC

config ROBOT_BASE_4MEC_DISTANCE_X
    int "wheel separation(0.1mm)"
    range 1 10000
    default 950
    depends on ROBOT_BASE_4MEC

config ROBOT_BASE_4MEC_DISTANCE_Y
    int "wheel separation(0.1mm)"
    range 1 10000
    default 1000
    depends on ROBOT_BASE_4MEC

endchoice # ROBOT_BASE_CONFIG

choice ICM42605_CONFIG
    prompt "ICM42605 config"

config ICM42605_USE_HARD_I2C
    bool "hard i2c"

config ICM42605_USE_HARD_SPI
    bool "hard spi"

endchoice # ICM42605_CONFIG

choice PS2_CONTROLLER_CONFIG
    prompt "PS2 controller config"

config PS2_USE_HARD_SPI
    bool "hard spi"

config PS2_USE_SOFT_SPI
    bool "soft spi"

endchoice # PS2_CONTROLLER_CONFIG

endmenu # BOARD_STM32F405_CROBOT_DEVICE_CONFIG
```

## device/soc/stm32/stm32f4xx/Kconfig.liteos_m.series
```kconfig
# Copyright (c) 2021 Bestechnic (Shanghai) Co., Ltd. All rights reserved.
# Licensed under the Apache License, Version 2.0 (the "License");
# you may not use this file except in compliance with the License.
# You may obtain a copy of the License at
#
#     http://www.apache.org/licenses/LICENSE-2.0
#
# Unless required by applicable law or agreed to in writing, software
# distributed under the License is distributed on an "AS IS" BASIS,
# WITHOUT WARRANTIES OR CONDITIONS OF ANY KIND, either express or implied.
# See the License for the specific language governing permissions and
# limitations under the License.

config SOC_SERIES_STM32F4XX
    bool "stm32F4XX chip"
    select ARCH_ARM
    select SOC_COMPANY_STM32
    select CPU_CORTEX_M4
    help
        Enable support for STM32F4XX
```
